#define SIMULATOR_FILE

#include "stm32f4xx.h"
#include "BSP_DWT.h"
#include "Driver_Simulator.h"
#include "Driver_Monitor.h"
#include "Driver_Judge.h"
#include "param.h"

static SimulatedData_Struct SIMULATOR_InfoData;

static const uint8_t NormalSequence[3][8] = {
    {0x5A, 0x01, 0x00, 0x00, 0x00, 0x01, 0x01, 0xFF},
    {0xFF, 0x01, 0x00, 0x00, 0x15, 0xE5, 0x00, 0x65},
    {0xCB, 0x00, 0x00, 0x00, 0x00, 0x00, 0x00, 0x00}
};

static const uint8_t InitSequence[58][3][8] = {
    {{0x5A, 0x01, 0x00, 0x00, 0x00, 0x01, 0x01, 0xFF},
     {0xFF, 0x01, 0x00, 0x03, 0x15, 0xB0, 0x01, 0x6E},
     {0x52, 0x00, 0x00, 0x00, 0x00, 0x00, 0x00, 0x00}},
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    {{0x5A, 0x01, 0x00, 0x00, 0x00, 0x01, 0x01, 0xFF}, 
     {0xFF, 0x01, 0x00, 0x03, 0x15, 0xB0, 0x64, 0xC5}, 
     {0x66, 0x00, 0x00, 0x00, 0x00, 0x00, 0x00, 0x00}}
};

static const uint8_t CameraSequence[10][3][8] = {
    {{0x5A, 0x02, 0x00, 0x00, 0x00, 0x01, 0x01, 0x06}, 
     {0x00, 0x01, 0x00, 0x04, 0x00, 0xE9, 0x01, 0x01}, 
     {0x0D, 0x2B, 0x00, 0x00, 0x00, 0x00, 0x00, 0x00}}, 
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    {{0x5A, 0x02, 0x00, 0x00, 0x00, 0x01, 0x0A, 0x06}, 
     {0x00, 0x01, 0x00, 0x04, 0x00, 0x5F, 0x01, 0x0A}, 
     {0x05, 0xD4, 0x00, 0x00, 0x00, 0x00, 0x00, 0x00}}
};

static const uint8_t ArmorSequence[4][10][3][8] = {
    // 0x140
    {{{0x5A, 0x02, 0x00, 0x00, 0x00, 0x01, 0x01, 0x02},
      {0x00, 0x01, 0x00, 0x04, 0x00, 0x35, 0x01, 0x01},
      {0x44, 0x3E, 0x00, 0x00, 0x00, 0x00, 0x00, 0x00}},
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     {{0x5A, 0x02, 0x00, 0x00, 0x00, 0x01, 0x0A, 0x02},
      {0x00, 0x01, 0x00, 0x04, 0x00, 0x83, 0x01, 0x0A},
      {0x4C, 0xC1, 0x00, 0x00, 0x00, 0x00, 0x00, 0x00}}},

    //0x141
    {{{0x5A, 0x02, 0x00, 0x00, 0x00, 0x01, 0x01, 0x02},
      {0x01, 0x01, 0x00, 0x04, 0x00, 0xF8, 0x01, 0x01},
      {0x1E, 0x4A, 0x00, 0x00, 0x00, 0x00, 0x00, 0x00}},
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     {{0x5A, 0x02, 0x00, 0x00, 0x00, 0x01, 0x0A, 0x02},
      {0x01, 0x01, 0x00, 0x04, 0x00, 0x4E, 0x01, 0x0A},
      {0x16, 0xB5, 0x00, 0x00, 0x00, 0x00, 0x00, 0x00}}},

    // 0x142
    {{{0x5A, 0x02, 0x00, 0x00, 0x00, 0x01, 0x01, 0x02},
      {0x02, 0x01, 0x00, 0x04, 0x00, 0xB6, 0x01, 0x01},
      {0xA3, 0xD6, 0x00, 0x00, 0x00, 0x00, 0x00, 0x00}},
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     {{0x5A, 0x02, 0x00, 0x00, 0x00, 0x01, 0x0A, 0x02},
      {0x02, 0x01, 0x00, 0x04, 0x00, 0x00, 0x01, 0x0A},
      {0xAB, 0x29, 0x00, 0x00, 0x00, 0x00, 0x00, 0x00}}},

    // 0x143
    {{{0x5A, 0x02, 0x00, 0x00, 0x00, 0x01, 0x01, 0x02},
      {0x03, 0x01, 0x00, 0x04, 0x00, 0x7B, 0x01, 0x01},
      {0xF9, 0xA2, 0x00, 0x00, 0x00, 0x00, 0x00, 0x00}},
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     {{0x5A, 0x02, 0x00, 0x00, 0x00, 0x01, 0x0A, 0x02},
      {0x03, 0x01, 0x00, 0x04, 0x00, 0xCD, 0x01, 0x0A},
      {0xF1, 0x5D, 0x00, 0x00, 0x00, 0x00, 0x00, 0x00}}}
};

static CanTxMsg CanTxData;
static uint8_t SampleCount;

static void VoltageConversion(void) {
    SIMULATOR_VoltageBuffer[SampleCount] =
        SIMULATOR_DataBuffer[3] * 0.008862305f;
}

static void CurrentConversion(void) {
    SIMULATOR_CurrentBuffer[SampleCount] = 
        (SIMULATOR_DataBuffer[11]-3172)*0.000805861/0.02f;
    if (SIMULATOR_CurrentBuffer[SampleCount] < 0.00001f)
        SIMULATOR_CurrentBuffer[SampleCount] = 0.00001f;
}

void SIMULATOR_Init(void) {
    CanTxData.StdId = 0x0FE;
    CanTxData.IDE = CAN_ID_STD;
    CanTxData.RTR = CAN_RTR_DATA;
    CanTxData.DLC = 8;
    for (uint16_t i = 0; i < 57; ++i) {
        for (int16_t j = 0; j < 3; ++j) {
            for (uint16_t k = 0; k < 8; ++k)
                CanTxData.Data[k] = InitSequence[i][j][k];
            CAN_Transmit(CAN1, &CanTxData);
        }
        SIMULATOR_SendHeartBeat();
    }

    SIMULATOR_Data.remainLife = 1500;
    SIMULATOR_Data.remainEnergy = 60.0f;
}

void SIMULATOR_SendHeartBeat(void) {
    CanTxData.StdId = 0x0FE;
    CanTxData.IDE = CAN_ID_STD;
    CanTxData.RTR = CAN_RTR_DATA;
    CanTxData.DLC = 8;
    for (uint16_t i = 0; i < 3; ++i) {
        for (uint16_t j = 0; j < 8; ++j)
            CanTxData.Data[j] = NormalSequence[i][j];
        CAN_Transmit(CAN1, &CanTxData);
        if (i==2) CanTxData.DLC = 2;
    }
}

void SIMULATOR_CameraInit(uint8_t robotId) {
    CanTxData.StdId = 0x130;
    CanTxData.IDE = CAN_ID_STD;
    CanTxData.RTR = CAN_RTR_DATA;
    CanTxData.DLC = 8;
    for (uint16_t i = 0; i < 3; ++i) {
        for (uint16_t j = 0; j < 8; ++j)
            CanTxData.Data[j] = CameraSequence[robotId][i][j];
        CAN_Transmit(CAN1, &CanTxData);
    }
}

void SIMULATOR_ArmorInit(uint8_t armorId, uint8_t robotId) {
    CanTxData.StdId = 0x140 | armorId;
    CanTxData.IDE = CAN_ID_STD;
    CanTxData.RTR = CAN_RTR_DATA;
    CanTxData.DLC = 8;
    for (uint16_t i = 0; i < 3; ++i) {
        for (uint16_t j = 0; j < 8; ++j)
            CanTxData.Data[j] = ArmorSequence[armorId][robotId][i][j];
        CAN_Transmit(CAN1, &CanTxData);
    }
}

void SIMULATOR_UpdatePower(void) {
    static float tmpCurrent, tmpVoltage;
    static float ratio;

    VoltageConversion();
    CurrentConversion();
    ++SampleCount;

    if (SampleCount != 19) return;

    tmpCurrent = tmpVoltage = 0.0f;
    for (uint8_t i = 0; i < 20; ++i) {
        tmpCurrent += SIMULATOR_CurrentBuffer[i];
        tmpVoltage += SIMULATOR_VoltageBuffer[i];
    }
    SIMULATOR_Data.current = tmpCurrent/20.0f;
    SIMULATOR_Data.voltage = tmpVoltage/20.0f;
    SIMULATOR_Data.power = SIMULATOR_Data.current * SIMULATOR_Data.voltage;

    SIMULATOR_Data.remainEnergy = SIMULATOR_Data.remainEnergy -
        (SIMULATOR_Data.power - CHASSIS_MAX_POWER) * 0.02f;
    if (SIMULATOR_Data.remainEnergy > 60.0f)
        SIMULATOR_Data.remainEnergy = 60.0f;
    else if (SIMULATOR_Data.remainEnergy < 0.0f) {
        SIMULATOR_Data.remainEnergy = 0.0f;
        ratio = (SIMULATOR_Data.power - CHASSIS_MAX_POWER) / CHASSIS_MAX_POWER;
        if (ratio <= 0.1f)
            SIMULATOR_Data.remainLife -= 3;
        else if (ratio <= 0.2f)
            SIMULATOR_Data.remainLife -= 6;
        else
            SIMULATOR_Data.remainLife -= 12;

        if (SIMULATOR_Data.remainLife < 0)
            SIMULATOR_Data.remainLife = 0;
    }
    SampleCount = 0;

    /* send info data */
    SIMULATOR_InfoData.remainLifeValue = SIMULATOR_Data.remainLife;
    SIMULATOR_InfoData.realChassisOutV = SIMULATOR_Data.voltage;
    SIMULATOR_InfoData.realChassisOutA = SIMULATOR_Data.current;
    MONITOR_Send((uint8_t*)&SIMULATOR_InfoData, sizeof(SIMULATOR_InfoData));
}

void SIMULATOR_Hit(void) {
    SIMULATOR_Data.remainLife -= 50;
    if (SIMULATOR_Data.remainLife < 0)
        SIMULATOR_Data.remainLife = 0;
}
